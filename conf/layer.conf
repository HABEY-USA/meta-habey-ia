## conf/layer.conf
```bitbake
# We have a conf and classes directory, add to BBPATH
BBPATH .= ":${LAYERDIR}"

# We have recipes-* directories, add to BBFILES

BBFILE_COLLECTIONS += "habey-ia"
BBFILE_PATTERN_habey-ia := "^${LAYERDIR}/"
BBFILE_PRIORITY_habey-ia = "5"

# Additional license directories.

# This should only be incremented on significant changes that will
# cause compatibility issues with other layers
LAYERVERSION_habey-ia = "3"
```

## meta-mitx-6772/conf/layer.conf
```bitbake
#We have a conf and classes directory, add to BBPATH
BBPATH .= ":${LAYERDIR}"

# We have a recipes directory, add to BBFILES
BBFILES += "${LAYERDIR}/recipes-*/*/*.bb \
	${LAYERDIR}/recipes-*/*/*.bbappend"

BBFILE_COLLECTIONS += "mitx-6772"
BBFILE_PATTERN_mitx-6772 := "^${LAYERDIR}/"
BBFILE_PRIORITY_mitx-6772 = "6"

LAYERDEPENDS_mitx-6772 = "intel"
```
